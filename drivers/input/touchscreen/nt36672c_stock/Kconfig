## drivers/input/touchscreen/nt36672c_stock/Kconfig
```kconfig
#
# Novatek NT36xxx touchscreen driver configuration
#
config TOUCHSCREEN_NT36xxx_HOSTDL_SPI_STOCK
	bool "Novatek NT36xxx host download SPI driver"
	depends on !TOUCHSCREEN_NT36xxx_HOSTDL_SPI
	help
	  Say Y here if you have a Novatek NT36xxx no flash touchscreen connected
	  to your system by SPI bus.

	  If unsure, say N.

config TOUCHSCREEN_NVT_DEBUG_FS_STOCK
	bool "Touch debug interface"
	depends on !TOUCHSCREEN_NT36xxx_HOSTDL_SPI && TOUCHSCREEN_NT36xxx_HOSTDL_SPI_STOCK
	help
	  Control IRQ,suspend,sensor,debug firmware,etc.
```
